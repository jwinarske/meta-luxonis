## conf/layer.conf
```bitbake
# We have a conf and classes directory, append to BBPATH
BBPATH .= ":${LAYERDIR}"

# We have a recipes directory, add to BBFILES
BBFILES += "${LAYERDIR}/recipes*/*/*.bb ${LAYERDIR}/recipes*/*/*.bbappend"

BBFILE_COLLECTIONS += "luxonis-layer"
BBFILE_PATTERN_luxonis-layer := "^${LAYERDIR}/"
BBFILE_PRIORITY_luxonis-layer = "12"
LAYERSERIES_COMPAT_luxonis-layer = "kirkstone"
LAYERDEPENDS_luxonis-layer = "core"
```
